#include "homerow.dtsi"

// layers
#define MAIN 0
#define SYM 1
#define NUM 2
#define ACC 3
#define NAV 4

// Home modifiers
#define CTL_Q &hm_asemi LCTRL Q
#define ALT_W &hm_sl LALT W
#define CMD_F &hm_dk LGUI F
#define SFT_T &hm_fj LSHFT T
#define SFT_N &hm_fj LSHFT N
#define CMD_U &hm_dk LGUI U
#define ALT_Y &hm_sl LALT Y
#define CTL_SEMI &hm_asemi LCTRL SEMI

// layer shortcuts
#define ESC_NUM &th_ht NUM ESC
#define SYM_BSP &th_ht SYM BSPC
#define TAB_SFT &th_ht LSHFT TAB
#define MIN_ARR &th_ht ACC MINUS
#define SPC_NAV &th_ht NAV SPACE
#define ENT_THU &th_ht ACC ENTER

// Nav shortcuts
#define P_HIST &kp LG(RBKT)
#define N_HIST &kp LG(LBKT)
#define P_TAB &kp LG(LS(LBKT))
#define N_TAB &kp LG(LS(RBKT))
#define N_WIND &kp LG(GRAVE)
#define SCR_CAP &kp LG(LS(N5))

//homerow
#define HM_A &hm_asemi LGUI A
#define HM_S &hm_sl LALT S
#define HM_D &hm_dk LCTRL D
#define HM_F &hm_fj LSHFT F
#define HM_G &hm_gh ACC G
#define HM_SEMI &hm_asemi LGUI SEMI
#define HM_L &hm_sl LALT L
#define HM_K &hm_dk LCTRL K
#define HM_J &hm_fj LSHFT J
#define HM_H &hm_gh ACC H

//bluetooth
#define BT0 &bt BT_SEL 0 
#define BT1 &bt BT_SEL 1 
#define BT2 &bt BT_SEL 2 
#define BT3 &bt BT_SEL 3 
#define BT4 &bt BT_SEL 4 
#define BT_CLEAR &bt BT_CLR
